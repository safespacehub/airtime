## build/circuitdojo_feather_nrf9151/Kconfig/Kconfig.shield
```kconfig
osource "/home/turbo/airtime2/nfed/boards/shields/*/Kconfig.shield"
osource "/home/turbo/airtime2/nrf/boards/shields/*/Kconfig.shield"
```

## build/circuitdojo_feather_nrf9151/Kconfig/boards/Kconfig.circuitdojo_feather_nrf9151
```kconfig
# Load board Kconfig descriptions.
osource "/home/turbo/airtime2/nfed/boards/circuitdojo/feather_nrf9151/Kconfig.circuitdojo_feather_nrf9151"
```

## build/circuitdojo_feather_nrf9151/app/Kconfig/Kconfig.shield.defconfig
```kconfig
osource "/home/turbo/airtime2/nfed/boards/shields/*/Kconfig.defconfig"
osource "/home/turbo/airtime2/nrf/boards/shields/*/Kconfig.defconfig"
```

## build/circuitdojo_feather_nrf9151/app/Kconfig/arch/Kconfig
```kconfig
# Load Zephyr Arch Kconfig descriptions.
osource "/home/turbo/airtime2/zephyr/arch/x86/Kconfig"
osource "/home/turbo/airtime2/zephyr/arch/xtensa/Kconfig"
osource "/home/turbo/airtime2/zephyr/arch/sparc/Kconfig"
osource "/home/turbo/airtime2/zephyr/arch/riscv/Kconfig"
osource "/home/turbo/airtime2/zephyr/arch/posix/Kconfig"
osource "/home/turbo/airtime2/zephyr/arch/nios2/Kconfig"
osource "/home/turbo/airtime2/zephyr/arch/mips/Kconfig"
osource "/home/turbo/airtime2/zephyr/arch/arm64/Kconfig"
osource "/home/turbo/airtime2/zephyr/arch/arm/Kconfig"
osource "/home/turbo/airtime2/zephyr/arch/arc/Kconfig"
```

## build/circuitdojo_feather_nrf9151/mcuboot/Kconfig/boards/Kconfig
```kconfig
# Load Zephyr board Kconfig descriptions.
osource "/home/turbo/airtime2/nfed/boards/circuitdojo/feather_nrf9151/Kconfig"
```

## build/circuitdojo_feather_nrf9151/mcuboot/Kconfig/boards/Kconfig.defconfig
```kconfig
# Load Zephyr board defconfig descriptions.
osource "/home/turbo/airtime2/nfed/boards/circuitdojo/feather_nrf9151/Kconfig.defconfig"
```

## build/circuitdojo_feather_nrf9151/mcuboot/Kconfig/soc/Kconfig
```kconfig
# Load Zephyr SoC Kconfig descriptions.
osource "/home/turbo/airtime2/zephyr/soc/xlnx/zynqmp/Kconfig"
osource "/home/turbo/airtime2/zephyr/soc/xlnx/zynq7000/Kconfig"
osource "/home/turbo/airtime2/zephyr/soc/xen/Kconfig"
osource "/home/turbo/airtime2/zephyr/soc/wch/ch32v00x/Kconfig"
osource "/home/turbo/airtime2/zephyr/soc/ti/simplelink/Kconfig"
osource "/home/turbo/airtime2/zephyr/soc/ti/lm3s6965/Kconfig"
osource "/home/turbo/airtime2/zephyr/soc/ti/k3/Kconfig"
osource "/home/turbo/airtime2/zephyr/soc/telink/tlsr/Kconfig"
osource "/home/turbo/airtime2/zephyr/soc/starfive/jh71xx/Kconfig"
osource "/home/turbo/airtime2/zephyr/soc/st/stm32/Kconfig"
osource "/home/turbo/airtime2/zephyr/soc/snps/qemu_arc/Kconfig"
osource "/home/turbo/airtime2/zephyr/soc/snps/nsim/arc_v/Kconfig"
osource "/home/turbo/airtime2/zephyr/soc/snps/nsim/arc_classic/Kconfig"
osource "/home/turbo/airtime2/zephyr/soc/snps/hsdk4xd/Kconfig"
osource "/home/turbo/airtime2/zephyr/soc/snps/hsdk/Kconfig"
osource "/home/turbo/airtime2/zephyr/soc/snps/emsk/Kconfig"
osource "/home/turbo/airtime2/zephyr/soc/snps/emsdp/Kconfig"
osource "/home/turbo/airtime2/zephyr/soc/snps/arc_iot/Kconfig"
osource "/home/turbo/airtime2/zephyr/soc/silabs/Kconfig"
osource "/home/turbo/airtime2/zephyr/soc/sifive/sifive_freedom/Kconfig"
osource "/home/turbo/airtime2/zephyr/soc/sensry/Kconfig"
osource "/home/turbo/airtime2/zephyr/soc/rockchip/Kconfig"
osource "/home/turbo/airtime2/zephyr/soc/renode/riscv_virtual/Kconfig"
osource "/home/turbo/airtime2/zephyr/soc/renode/cortex_r8_virtual/Kconfig"
osource "/home/turbo/airtime2/zephyr/soc/renesas/smartbond/Kconfig"
osource "/home/turbo/airtime2/zephyr/soc/renesas/rzt2m/Kconfig"
osource "/home/turbo/airtime2/zephyr/soc/renesas/rz/Kconfig"
osource "/home/turbo/airtime2/zephyr/soc/renesas/rcar/Kconfig"
osource "/home/turbo/airtime2/zephyr/soc/renesas/ra/Kconfig"
osource "/home/turbo/airtime2/zephyr/soc/realtek/ec/Kconfig"
osource "/home/turbo/airtime2/zephyr/soc/raspberrypi/rpi_pico/Kconfig"
osource "/home/turbo/airtime2/zephyr/soc/quicklogic/eos_s3/Kconfig"
osource "/home/turbo/airtime2/zephyr/soc/qemu/virt_riscv/Kconfig"
osource "/home/turbo/airtime2/zephyr/soc/qemu/malta/Kconfig"
osource "/home/turbo/airtime2/zephyr/soc/openisa/rv32m1/Kconfig"
osource "/home/turbo/airtime2/zephyr/soc/nxp/s32/Kconfig"
osource "/home/turbo/airtime2/zephyr/soc/nxp/rw/Kconfig"
osource "/home/turbo/airtime2/zephyr/soc/nxp/mcx/Kconfig"
osource "/home/turbo/airtime2/zephyr/soc/nxp/lpc/Kconfig"
osource "/home/turbo/airtime2/zephyr/soc/nxp/layerscape/Kconfig"
osource "/home/turbo/airtime2/zephyr/soc/nxp/kinetis/Kconfig"
osource "/home/turbo/airtime2/zephyr/soc/nxp/imxrt/Kconfig"
osource "/home/turbo/airtime2/zephyr/soc/nxp/imx/Kconfig"
osource "/home/turbo/airtime2/zephyr/soc/nuvoton/numicro/Kconfig"
osource "/home/turbo/airtime2/zephyr/soc/nuvoton/numaker/Kconfig"
osource "/home/turbo/airtime2/zephyr/soc/nuvoton/npcx/Kconfig"
osource "/home/turbo/airtime2/zephyr/soc/nuvoton/npcm/Kconfig"
osource "/home/turbo/airtime2/zephyr/soc/nordic/Kconfig"
osource "/home/turbo/airtime2/zephyr/soc/neorv32/Kconfig"
osource "/home/turbo/airtime2/zephyr/soc/native/inf_clock/Kconfig"
osource "/home/turbo/airtime2/zephyr/soc/microchip/miv/Kconfig"
osource "/home/turbo/airtime2/zephyr/soc/microchip/mec/Kconfig"
osource "/home/turbo/airtime2/zephyr/soc/mediatek/mt8xxx/Kconfig"
osource "/home/turbo/airtime2/zephyr/soc/lowrisc/opentitan/Kconfig"
osource "/home/turbo/airtime2/zephyr/soc/litex/litex_vexriscv/Kconfig"
osource "/home/turbo/airtime2/zephyr/soc/ite/ec/Kconfig"
osource "/home/turbo/airtime2/zephyr/soc/intel/raptor_lake/Kconfig"
osource "/home/turbo/airtime2/zephyr/soc/intel/lakemont/Kconfig"
osource "/home/turbo/airtime2/zephyr/soc/intel/intel_socfpga_std/Kconfig"
osource "/home/turbo/airtime2/zephyr/soc/intel/intel_socfpga/Kconfig"
osource "/home/turbo/airtime2/zephyr/soc/intel/intel_niosv/Kconfig"
osource "/home/turbo/airtime2/zephyr/soc/intel/intel_ish/Kconfig"
osource "/home/turbo/airtime2/zephyr/soc/intel/intel_adsp/Kconfig"
osource "/home/turbo/airtime2/zephyr/soc/intel/elkhart_lake/Kconfig"
osource "/home/turbo/airtime2/zephyr/soc/intel/atom/Kconfig"
osource "/home/turbo/airtime2/zephyr/soc/intel/apollo_lake/Kconfig"
osource "/home/turbo/airtime2/zephyr/soc/intel/alder_lake/Kconfig"
osource "/home/turbo/airtime2/zephyr/soc/infineon/cat3/Kconfig"
osource "/home/turbo/airtime2/zephyr/soc/infineon/cat1b/Kconfig"
osource "/home/turbo/airtime2/zephyr/soc/infineon/cat1a/Kconfig"
osource "/home/turbo/airtime2/zephyr/soc/gd/gd32/Kconfig"
osource "/home/turbo/airtime2/zephyr/soc/gaisler/leon3/Kconfig"
osource "/home/turbo/airtime2/zephyr/soc/gaisler/gr716a/Kconfig"
osource "/home/turbo/airtime2/zephyr/soc/espressif/Kconfig"
osource "/home/turbo/airtime2/zephyr/soc/ene/kb1200/Kconfig"
osource "/home/turbo/airtime2/zephyr/soc/efinix/sapphire/Kconfig"
osource "/home/turbo/airtime2/zephyr/soc/cdns/xtensa_sample_controller/Kconfig"
osource "/home/turbo/airtime2/zephyr/soc/cdns/sample_controller32/Kconfig"
osource "/home/turbo/airtime2/zephyr/soc/cdns/dc233c/Kconfig"
osource "/home/turbo/airtime2/zephyr/soc/brcm/bcmvk/Kconfig"
osource "/home/turbo/airtime2/zephyr/soc/brcm/bcm2712/Kconfig"
osource "/home/turbo/airtime2/zephyr/soc/brcm/bcm2711/Kconfig"
osource "/home/turbo/airtime2/zephyr/soc/atmel/sam0/Kconfig"
osource "/home/turbo/airtime2/zephyr/soc/atmel/sam/Kconfig"
osource "/home/turbo/airtime2/zephyr/soc/aspeed/Kconfig"
osource "/home/turbo/airtime2/zephyr/soc/arm/Kconfig"
osource "/home/turbo/airtime2/zephyr/soc/arm/beetle/Kconfig"
osource "/home/turbo/airtime2/zephyr/soc/andestech/Kconfig"
osource "/home/turbo/airtime2/zephyr/soc/amd/acp_6_0/Kconfig"
osource "/home/turbo/airtime2/zephyr/soc/ambiq/Kconfig"
osource "/home/turbo/airtime2/zephyr/soc/altr/zephyr_nios2f/Kconfig"
osource "/home/turbo/airtime2/zephyr/soc/altr/qemu_nios2/Kconfig"
osource "/home/turbo/airtime2/zephyr/soc/adi/max32/Kconfig"
osource "/home/turbo/airtime2/nrf/soc/nordic/Kconfig"
```

## samples/active_sleep/boards/circuitdojo_feather_nrf9160_ns.conf
```kconfig
# Partition manager settings
CONFIG_PM_EXTERNAL_FLASH_MCUBOOT_SECONDARY=n
CONFIG_PM_OVERRIDE_EXTERNAL_DRIVER_CHECK=y

# Disable divider
CONFIG_VOLTAGE_DIVIDER=n
```

## samples/gps/boards/circuitdojo_feather_nrf9161_ns.conf
```kconfig
# GPS Antenna configuration
CONFIG_MODEM_ANTENNA=y
CONFIG_MODEM_ANTENNA_AT_COEX0="AT\%XCOEX0=1,1,1565,1586"
```
